## config/west.yml
```yaml
manifest:
  remotes:
    - name: zmkfirmware
      url-base: https://github.com/zmkfirmware
    # Additional modules containing boards/shields/custom code can be listed here as well
    # See https://docs.zephyrproject.org/3.2.0/develop/west/manifest.html#projects
      - name: m165437 #for gem view
      url-base: https://github.com/M165437  #for gem view
  projects:
    - name: zmk
      remote: zmkfirmware
      revision: main
      import: app/west.yml
    - name: nice-view-gem #for gem view
      remote: m165437 #for gem view
      revision: main #for gem view
  self:
    path: config
```
